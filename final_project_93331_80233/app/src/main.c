/*
 * Copyright (c) 2012-2014 Wind River Systems, Inc.
 *
 * SPDX-License-Identifier: Apache-2.0
 */

#include <zephyr.h>
#include <device.h>
#include <drivers/gpio.h>
#include <drivers/uart.h>
#include <sys/__assert.h>
#include <timing/timing.h>
#include "cab.h"
#include "img_algo.h"

/* Size of stack area used by each thread (can be thread specific, if necessary)*/
#define STACK_SIZE 2048

/* Thread scheduling priority */
#define thread_NOD_prio 1	 /* Near obstacle detection thread, critical task, highest priority */
#define thread_OBSC_prio 3	 /* Obstacle count thread, non real-time */
#define thread_OAP_prio 2	 /* Orientation and position thread, soft task */
#define thread_OUTPUT_prio 1 /* OAP update thread, critical task, highest priority */
#define thread_RXDATA_prio -1 /* Thread to handle the reception of serial port data */

/* Uart declarations and defines */
#define UART_NODE DT_NODELABEL(uart0)    /* UART Node label, see dts */
#define BUFFERSIZE IMGHEIGHT*IMGWIDTH
#define RX_TIMEOUT 1000
#define FATAL_ERR -1 /* Fatal error return code, app terminates */

/* Struct for UART configuration (if using default values is not needed) */
const struct uart_config uart_cfg = {
		.baudrate = 115200,
		.parity = UART_CFG_PARITY_NONE,
		.stop_bits = UART_CFG_STOP_BITS_1,
		.data_bits = UART_CFG_DATA_BITS_8,
		.flow_ctrl = UART_CFG_FLOW_CTRL_NONE
};

/* UART related variables */
const struct device *uart_dev;          /* Pointer to device struct */ 
static uint8_t rx_buf[BUFFERSIZE];  /* RX buffer, to store received data */
static uint8_t rx_buf_rsp[BUFFERSIZE]; /* Buffer used for continuos reception */
static uint8_t rx_chars[BUFFERSIZE];    /* chars actually received  */
volatile int rx=0;        /* Number of chars currnetly on the rx buffer */


/* UART callback function prototype */
static void uart_cb(const struct device *dev, struct uart_event *evt, void *user_data);

/* Create thread stack space */
K_THREAD_STACK_DEFINE(thread_NOD_stack, STACK_SIZE);
K_THREAD_STACK_DEFINE(thread_OBSC_stack, STACK_SIZE);
K_THREAD_STACK_DEFINE(thread_OAP_stack, STACK_SIZE);
K_THREAD_STACK_DEFINE(thread_OUTPUT_stack, STACK_SIZE);
K_THREAD_STACK_DEFINE(thread_RXDATA_stack, STACK_SIZE);

/* Create variables for thread data */
struct k_thread thread_NOD_data;
struct k_thread thread_OBSC_data;
struct k_thread thread_OAP_data;
struct k_thread thread_OUTPUT_data;
struct k_thread thread_RXDATA_data;

/* Create task IDs */
k_tid_t thread_NOD_tid;
k_tid_t thread_OBSC_tid;
k_tid_t thread_OAP_tid;
k_tid_t thread_OUTPUT_tid;
k_tid_t thread_RXDATA_tid;

/* Thread code prototypes */
void thread_NOD_code(void *argA, void *argB, void *argC);
void thread_OBSC_code(void *argA, void *argB, void *argC);
void thread_OAP_code(void *argA, void *argB, void *argC);
void thread_OUTPUT_code(void *argA, void *argB, void *argC);
void thread_RXDATA_code(void *argA, void *argB, void *argC);

/* Global Variables */
uint8_t flag;
uint16_t obs;
float angle;
uint16_t pos;

/* Image simulation */
uint8_t buffer[IMGHEIGHT][IMGWIDTH]= 
	{	{0x00, 0xFF, 0x00, 0x00, 0x00, 0x00, 0x00, 0x00, 0x00, 0x00, 0x80, 0x80, 0x00,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 0x00, 0xFF}, 
		{0x00, 0x00, 0x00, 0x80, 0x00, 0x00, 0x00, 0xFF, 0x00, 0x00, 0x00, 0x00, 0x00,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 0x00, 0x00}, 
		{0x00, 0x00, 0x00, 0x80, 0x00, 0x00, 0x00, 0xFF, 0x00, 0x00, 0x00, 0x00, 0x00,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 0x00, 0x00},
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		{0x00, 0x00, 0x00, 0x00, 0x00, 0x00, 0x00, 0xFF, 0x00, 0x00, 0x00, 0x00, 0x00,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 0x00, 0xFF} 
	};

/* CAB declaration */
cab* cab_RX;

/* Semaphores for task synch */
struct k_sem sem_NOD;
struct k_sem sem_OUTPUT;
struct k_sem sem_OAP;
struct k_sem sem_OBSC;

void main(void)
{
	int err;
	int arg1 = 0, arg2 = 0, arg3 = 0; // Input args of tasks (actually not used in this case)

	/* Initializing the CAB */
	cab_RX = open_cab("RX", 16384, 1, buffer);
	/* Bind to UART */
    uart_dev= device_get_binding(DT_LABEL(UART_NODE));
    if (uart_dev == NULL) {
        printk("device_get_binding() error for device %s!\n\r", DT_LABEL(UART_NODE));
        return;
    }
    else {
        printk("UART binding successful\n\r");
    }
	/* Configure UART */
    err = uart_configure(uart_dev, &uart_cfg);
    if (err == -ENOSYS) { /* If invalid configuration */
        printk("uart_configure() error. Invalid configuration\n\r");
        return; 
    }
	/* Register callback */
    err = uart_callback_set(uart_dev, uart_cb, NULL);
    if (err) {
        printk("uart_callback_set() error. Error code:%d\n\r",err);
        return;
    }
	/* Enable data reception */
    err =  uart_rx_enable(uart_dev ,rx_buf,sizeof(rx_buf), SYS_FOREVER_US);
    if (err) {
        printk("uart_rx_enable() error. Error code:%d\n\r",err);
        return;
    }

	/* Create and init semaphore */
    k_sem_init(&sem_NOD, 0, 1); 
	k_sem_init(&sem_OUTPUT, 0, 1);
	k_sem_init(&sem_OAP, 0, 1);
	k_sem_init(&sem_OBSC, 0, 1);


	/* Creation of tasks */
	thread_NOD_tid = k_thread_create(&thread_NOD_data, thread_NOD_stack,
									 K_THREAD_STACK_SIZEOF(thread_NOD_stack), thread_NOD_code,
									 &arg1, &arg2, &arg3, thread_NOD_prio, 0, K_NO_WAIT);

	thread_OUTPUT_tid = k_thread_create(&thread_OUTPUT_data, thread_OUTPUT_stack,
										K_THREAD_STACK_SIZEOF(thread_OUTPUT_stack), thread_OUTPUT_code,
										NULL, NULL, NULL, thread_OUTPUT_prio, 0, K_NO_WAIT);

	thread_OBSC_tid = k_thread_create(&thread_OBSC_data, thread_OBSC_stack,
										K_THREAD_STACK_SIZEOF(thread_OBSC_stack), thread_OBSC_code,
										NULL, NULL, NULL, thread_OBSC_prio, 0, K_NO_WAIT);

	thread_OAP_tid = k_thread_create(&thread_OAP_data, thread_OAP_stack,
										K_THREAD_STACK_SIZEOF(thread_OAP_stack), thread_OAP_code,
										NULL, NULL, NULL, thread_OAP_prio, 0, K_NO_WAIT);
	thread_RXDATA_tid = k_thread_create(&thread_RXDATA_data, thread_RXDATA_stack, 
										K_THREAD_STACK_SIZEOF(thread_RXDATA_stack), thread_RXDATA_code, 
										NULL, NULL, NULL, thread_RXDATA_prio , 0, K_NO_WAIT);
	

	return;
}

void thread_RXDATA_code(void *argA , void *argB, void *argC){
	int err;
	char arr[4] = {'A', 'C', 'K', '\0'};
	int c = 1;
	
    /* Main loop */
    while(1) {
        if(rx > 0){  
			uint8_t *img;
			img = (uint8_t *) reserve(cab_RX);
			memcpy(img, &rx_chars, cab_RX->size);
			put_mes(img, cab_RX);
            rx = 0;  /* Reset */
            err = uart_tx(uart_dev, arr, sizeof(arr), SYS_FOREVER_US);
            if (err) {
               printk("uart_tx() error. Error code:%d\n\r",err);
               return;
            }
			c++;
			k_sem_give(&sem_NOD);
			k_sem_give(&sem_OAP);
			k_sem_give(&sem_OBSC);
        }
		k_usleep(25361);
    }
}
/* Critical to the safety of the robot and should be executed at the highest possible rate.
 Worst case scenario: There is an obstacle in the last position of the CSA upper bound  
 After testing: WCET = 580us */
void thread_NOD_code(void *argA , void *argB, void *argC){
	uint32_t start, end, time;
	uint32_t wc_exec_time = 1;
	uint8_t *buff;

	while(1){
		k_sem_take(&sem_NOD, K_FOREVER);
		start = k_cycle_get_32(); 
		buff = (uint8_t *) get_mes(cab_RX);
		flag = nearObstSearch(buff);
		unget(buff, cab_RX);
		end = k_cycle_get_32();
		time = k_cyc_to_us_ceil32(end - start);
		if(wc_exec_time < time) wc_exec_time = time;
		//printk("----------------------\nThread NOD executed\nWCET -> %4u\n-----------------\n", wc_exec_time);
		k_sem_give(&sem_OUTPUT);
		
	}
}
/* Non-real time task 
   After testing: WCET = N */
void thread_OBSC_code(void *argA , void *argB, void *argC){
	uint32_t start, end, time;
	uint32_t wc_exec_time = 1;
	uint8_t* buff;

	while(1){
		k_sem_take(&sem_OBSC, K_FOREVER);
		start = k_cycle_get_32();
		buff = (uint8_t *) get_mes(cab_RX);
		obs = obstCount(buff);
		unget(buff, cab_RX);
		end = k_cycle_get_32();
		time = k_cyc_to_us_ceil32(end - start);
		if(wc_exec_time < time) wc_exec_time = time;
		//printk("----------------------\nThread OBSC executed\nWCET -> %4u\n-----------------\n", wc_exec_time);
		k_sem_give(&sem_OUTPUT);
	}
	
}
/* Soft real-time task, being executed at a second priority level.
 Worst case scenario: The guideline in GN is on the last index of its row, and GF is in the middle of its row
 After testing: WCET = 153us */
void thread_OAP_code(void *argA , void *argB, void *argC){
	
	uint32_t start, end, time;
	uint32_t wc_exec_time = 1;
	uint8_t* buff;

	while(1){
		k_sem_take(&sem_OAP, K_FOREVER);
		start = k_cycle_get_32();
		buff = (uint8_t *) get_mes(cab_RX);
		guideLineSearch(buff, &pos, &angle);
		unget(buff, cab_RX);
		end = k_cycle_get_32();
		time = k_cyc_to_us_ceil32(end - start);
		if(wc_exec_time < time) wc_exec_time = time;
		//printk("Angle (Radians): %f\n", angle);
    	//printk("Position (Percentage): %d%%\n", pos);
		//printk("-----------------\nThread OAP executed\nWCET -> %4u\n-----------------\n", wc_exec_time);
		k_sem_give(&sem_OUTPUT);
	}
}
/* Critical to the safety of the robot and should be executed at the highest possible rate. */
/* WCET = 24781us */
void thread_OUTPUT_code(void *argA , void *argB, void *argC){
	uint32_t start, end, time;
	uint32_t wc_exec_time = 1;

	while(1){
		k_sem_take(&sem_OUTPUT, K_FOREVER);
		start = k_cycle_get_32();
		printk("Near obstacle detection -> %4u\nOrientation and Position -> %f, %d%%\nNumber of obstacles -> %4u\n", flag, angle, pos, obs);
		end = k_cycle_get_32();
		time = k_cyc_to_us_ceil32(end - start);
		if(wc_exec_time < time) wc_exec_time = time;
		//printf("-----------------------\nThread OUTPUT executed\nWCET -> %4u\n-----------------", wc_exec_time);
	}
}

static void uart_cb(const struct device *dev, struct uart_event *evt, void *user_data)
{
    int err;

    switch (evt->type) {
	
        case UART_TX_DONE:
            break;

    	case UART_TX_ABORTED:
		    break;
		
	    case UART_RX_RDY:
			memcpy(&rx_chars, &(evt->data.rx.buf[evt->data.rx.offset]), evt->data.rx.len);
            rx++;   
		    break;

	    case UART_RX_BUF_REQUEST:
            uart_rx_buf_rsp(uart_dev, rx_buf_rsp, sizeof(rx_buf_rsp));

		    break;

	    case UART_RX_BUF_RELEASED:
		    break;
		
	    case UART_RX_DISABLED: 
            /* When the RX_BUFF becomes full RX is is disabled automaticaly.  */
            /* It must be re-enabled manually for continuous reception */
            //printk("UART_RX_DISABLED event \n\r");
		    err =  uart_rx_enable(uart_dev ,rx_buf,sizeof(rx_buf),RX_TIMEOUT);
            if (err) {
                printk("uart_rx_enable() error. Error code:%d\n\r",err);
                exit(FATAL_ERR);                
            }
		    break;

	    case UART_RX_STOPPED:
		    break;
		
	    default:
		    break;
    }

}